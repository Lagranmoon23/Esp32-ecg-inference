## firmware/main/Kconfig.projbuild
```kconfig
menu "ECG acquisition"

config ECG_ADC_CHANNEL
    int "AD8232 OUT ADC1 channel"
    range 0 9
    default 0
    help
        ESP32-S3 ADC1 channel 0 is GPIO1, channel 1 is GPIO2, and so on.

config ECG_LO_PLUS_GPIO
    int "AD8232 LO+ GPIO (-1 disables)"
    range -1 48
    default 2

config ECG_LO_MINUS_GPIO
    int "AD8232 LO- GPIO (-1 disables)"
    range -1 48
    default 3

config ECG_STREAM_EVERY_N
    int "Print one waveform row every N samples (0 disables)"
    range 0 360
    default 4

config ECG_RUN_GOLDEN_TEST
    bool "Run three exported golden vectors at startup"
    default n

endmenu
```

## firmware/sdkconfig.defaults
```kconfig
CONFIG_ESPTOOLPY_FLASHSIZE_16MB=y
CONFIG_PARTITION_TABLE_CUSTOM=y
CONFIG_PARTITION_TABLE_CUSTOM_FILENAME="partitions.csv"
CONFIG_COMPILER_CXX_EXCEPTIONS=n
CONFIG_COMPILER_CXX_RTTI=n
CONFIG_LOG_DEFAULT_LEVEL_INFO=y
CONFIG_ESP_MAIN_TASK_STACK_SIZE=8192
CONFIG_ESP_INT_WDT_TIMEOUT_MS=2000
CONFIG_SPIRAM=y
CONFIG_SPIRAM_MODE_OCT=y
CONFIG_SPIRAM_TYPE_AUTO=y
CONFIG_SPIRAM_SPEED_80M=y
CONFIG_SPIRAM_USE_MALLOC=y
CONFIG_SPIRAM_MEMTEST=y
CONFIG_SPIRAM_MALLOC_ALWAYSINTERNAL=16384
CONFIG_SPIRAM_MALLOC_RESERVE_INTERNAL=32768
```
